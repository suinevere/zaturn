/*----------------------
 | scene_map.c
 | Description: Runtime lookup for the per-game scene tables generated by
 |   tools/gen_scene_tables.py -- three array reads that replace keyword
 |   classification for any game with an authored scene map.
 | Author: suinevere
 | Dependencies: string.h (memcmp), scene_map.h, game_rooms.inc, game_tracks.inc
 ----------------------*/
#include <string.h>
#include "scene/scene_map.h"

#include "game_rooms.inc"
#include "game_tracks.inc"

/*----------------------
 | scene_game_index
 | Description: The GAME_ROOM_MAP row for one game, by release and 6-char
 |   serial.
 | Author: suinevere
 | Dependencies: string.h (memcmp), game_rooms.inc
 | Globals: GAME_ROOM_MAP
 | Params: release -- Z-machine release; serial -- 6-char serial, not
 |   guaranteed NUL-terminated
 | Returns: the row index into GAME_ROOM_MAP and SCENE_TRACKS, or -1 when the
 |   game is unlisted
 ----------------------*/
int scene_game_index(unsigned int release, const char *serial) {
    int i;
    for (i = 0; i < GAME_N; i++) {
        const GameRoomMap *g = &GAME_ROOM_MAP[i];
        if (g->release == release && memcmp(g->serial, serial, 6) == 0) return i;
    }
    return -1;
}

/*----------------------
 | scene_of_room
 | Description: The scene authored for one room of one game. Matches a
 |   GAME_ROOM_MAP row by release and 6-char serial, then indexes that game's
 |   256-byte map by the room's object number. Returns -1 when the game is
 |   unknown or the room carries no scene, which the caller treats as "hold
 |   whatever is showing".
 |
 |   The stored value is scene+1 so that 0 can mean unauthored without costing
 |   a separate presence table.
 | Author: suinevere
 | Dependencies: string.h (memcmp), game_rooms.inc
 | Globals: GAME_ROOM_MAP
 | Params: release -- Z-machine release; serial -- 6-char serial, not
 |   guaranteed NUL-terminated; obj -- the room's object number
 | Returns: an SC_* value, or -1
 ----------------------*/
int scene_of_room(unsigned int release, const char *serial, unsigned int obj) {
    int g = scene_game_index(release, serial);
    if (g < 0 || obj >= 256) return -1;
    {
        unsigned char v = GAME_ROOM_MAP[g].rooms[obj];
        return v ? (int) v - 1 : -1;
    }
}

/*----------------------
 | scene_name
 | Description: The display name for one SC_* scene, for tests and the
 |   options UI.
 | Author: suinevere
 | Dependencies: N/A
 | Globals: SCENE_NAME
 | Params: scene -- an SC_* value
 | Returns: the scene's name, or NULL when scene is out of range
 ----------------------*/
const char *scene_name(int scene) {
    if (scene < 0 || scene >= SCENE_N) return 0;
    return SCENE_NAME[scene];
}

/*----------------------
 | scene_track_mask
 | Description: The authored track mask for one scene of one game. A zero
 |   mask means no tracks were authored, which the caller treats as "fall
 |   back to the neutral pool".
 | Author: suinevere
 | Dependencies: game_tracks.inc
 | Globals: SCENE_TRACKS
 | Params: game -- a row index from scene_game_index; scene -- an SC_* value
 | Returns: the track mask, or 0 when either argument is out of range or the
 |   scene is unauthored
 ----------------------*/
unsigned long scene_track_mask(int game, int scene) {
    if (game < 0 || game >= GAME_N || scene < 0 || scene >= SCENE_N) return 0UL;
    return SCENE_TRACKS[game][scene];
}
