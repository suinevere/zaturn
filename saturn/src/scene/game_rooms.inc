/*----------------------
 | game_rooms.inc
 | Description: GENERATED FILE -- do not edit by hand; produced by
 |   tools/gen_scene_tables.py. Per-game 256-byte object-to-scene maps
 |   (value is scene index plus one, 0 meaning unmapped) and the
 |   GAME_ROOM_MAP table that keys them by release and serial.
 | Author: suinevere
 ----------------------*/
typedef struct {
    unsigned short release;
    const char *serial;
    const unsigned char *rooms;
} GameRoomMap;
static const unsigned char GAME_ROOM_ADVENT[256] = {
    0, 0, 0, 0, 0, 0, 0, 0, 0, 0, 0, 0, 0, 0, 0, 0,
    0, 0, 0, 0, 0, 9, 9, 9, 9, 9, 9, 9, 9, 9, 9, 9,
    0, 0, 0, 0, 0, 8, 0, 0, 0, 0, 0, 0, 7, 23, 11, 0,
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    0, 0, 0, 0, 0, 0, 0, 0, 0, 0, 0, 0, 0, 0, 0, 0,
};
static const unsigned char GAME_ROOM_BALLYHOO[256] = {
    0, 13, 0, 0, 0, 0, 0, 0, 0, 0, 0, 0, 0, 0, 0, 17,
    0, 0, 0, 0, 0, 0, 0, 0, 0, 0, 0, 0, 0, 0, 0, 0,
    0, 0, 0, 0, 0, 0, 0, 0, 0, 0, 0, 0, 0, 0, 0, 0,
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    0, 0, 0, 0, 0, 0, 0, 0, 0, 0, 0, 0, 0, 0, 0, 0,
};
static const unsigned char GAME_ROOM_CUTHROAT[256] = {
    0, 0, 0, 0, 0, 0, 0, 0, 0, 0, 0, 0, 0, 0, 0, 30,
    0, 30, 5, 0, 0, 0, 30, 0, 0, 0, 0, 30, 0, 5, 0, 0,
    30, 0, 0, 0, 0, 30, 0, 30, 0, 30, 0, 0, 0, 0, 30, 0,
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    0, 0, 0, 0, 0, 0, 0, 0, 0, 0, 0, 0, 0, 0, 0, 0,
};
static const unsigned char GAME_ROOM_DEADLINE[256] = {
    0, 0, 0, 0, 0, 0, 0, 0, 0, 0, 0, 0, 0, 0, 0, 0,
    0, 0, 0, 0, 0, 0, 0, 0, 0, 0, 0, 0, 0, 0, 0, 0,
    0, 0, 0, 0, 0, 0, 0, 0, 0, 0, 0, 0, 0, 0, 0, 0,
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    0, 0, 0, 0, 0, 0, 7, 0, 0, 0, 0, 0, 0, 0, 0, 0,
};
static const unsigned char GAME_ROOM_ENCHANTR[256] = {
    0, 0, 27, 0, 0, 0, 0, 0, 0, 7, 0, 0, 0, 0, 0, 0,
    0, 0, 0, 0, 0, 0, 2, 0, 0, 0, 0, 18, 0, 0, 0, 0,
    0, 0, 0, 29, 0, 0, 0, 0, 0, 0, 0, 23, 0, 7, 0, 0,
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    0, 0, 0, 0, 0, 0, 0, 0, 0, 14, 0, 0, 0, 23, 0, 0,
};
static const unsigned char GAME_ROOM_HITCHHKR[256] = {
    0, 0, 0, 0, 0, 0, 0, 0, 0, 0, 0, 0, 0, 0, 0, 0,
    0, 0, 0, 0, 0, 0, 0, 0, 0, 0, 0, 0, 0, 0, 0, 0,
    0, 0, 0, 0, 0, 0, 0, 0, 0, 0, 0, 0, 0, 0, 0, 0,
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    0, 0, 0, 0, 0, 0, 0, 0, 0, 0, 0, 0, 0, 0, 0, 0,
};
static const unsigned char GAME_ROOM_HOLYWOOD[256] = {
    0, 0, 0, 0, 0, 17, 0, 0, 0, 0, 0, 0, 0, 0, 0, 0,
    0, 0, 10, 0, 0, 0, 0, 0, 0, 0, 0, 0, 0, 0, 18, 0,
    0, 0, 0, 17, 22, 0, 0, 4, 0, 0, 0, 0, 0, 8, 0, 0,
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    0, 0, 0, 0, 23, 0, 0, 0, 0, 0, 0, 0, 0, 0, 0, 0,
};
static const unsigned char GAME_ROOM_HYPOCOND[256] = {
    0, 7, 0, 0, 0, 0, 0, 0, 0, 0, 0, 0, 0, 0, 0, 0,
    0, 0, 0, 0, 0, 0, 0, 0, 0, 0, 0, 0, 0, 0, 0, 0,
    0, 0, 0, 0, 0, 0, 0, 0, 0, 0, 0, 0, 0, 0, 0, 0,
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    0, 0, 0, 0, 0, 0, 0, 0, 0, 0, 0, 0, 0, 0, 0, 0,
};
static const unsigned char GAME_ROOM_INFIDEL[256] = {
    0, 0, 0, 0, 0, 0, 0, 0, 0, 0, 0, 0, 0, 0, 0, 0,
    0, 29, 8, 8, 8, 0, 0, 0, 0, 0, 3, 0, 0, 0, 0, 0,
    0, 0, 0, 0, 0, 0, 0, 0, 0, 0, 0, 0, 0, 0, 0, 0,
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    0, 0, 0, 0, 0, 0, 0, 0, 0, 0, 0, 0, 0, 0, 0, 0,
};
static const unsigned char GAME_ROOM_INFOSAM5[256] = {
    0, 0, 0, 0, 0, 0, 0, 0, 3, 0, 0, 0, 0, 0, 0, 0,
    0, 0, 0, 0, 0, 0, 0, 0, 0, 0, 0, 0, 0, 0, 0, 0,
    0, 0, 3, 3, 3, 3, 3, 3, 3, 3, 3, 13, 7, 13, 7, 7,
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    0, 0, 0, 0, 0, 0, 0, 0, 0, 0, 0, 0, 0, 0, 0, 0,
};
static const unsigned char GAME_ROOM_INFOSAM7[256] = {
    0, 0, 0, 0, 0, 0, 0, 0, 0, 0, 0, 0, 0, 0, 0, 0,
    0, 0, 0, 0, 4, 4, 0, 0, 0, 18, 0, 0, 0, 0, 1, 0,
    22, 0, 0, 0, 0, 0, 0, 0, 0, 0, 0, 0, 0, 0, 0, 0,
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    0, 0, 0, 0, 0, 0, 0, 0, 0, 0, 0, 0, 0, 0, 0, 0,
};
static const unsigned char GAME_ROOM_LEATHERG[256] = {
    0, 0, 0, 0, 0, 0, 0, 0, 0, 0, 0, 0, 0, 0, 0, 0,
    0, 12, 0, 0, 0, 0, 0, 0, 0, 16, 0, 0, 0, 0, 0, 0,
    0, 0, 0, 0, 0, 0, 0, 0, 0, 0, 13, 0, 0, 0, 0, 0,
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    0, 0, 0, 0, 0, 0, 0, 0, 0, 0, 0, 0, 0, 0, 0, 0,
};
static const unsigned char GAME_ROOM_LURKING[256] = {
    0, 0, 0, 0, 0, 0, 0, 0, 0, 12, 0, 0, 0, 0, 0, 8,
    2, 8, 0, 0, 0, 0, 0, 0, 0, 8, 0, 22, 0, 0, 0, 0,
    0, 18, 8, 23, 0, 0, 0, 8, 0, 0, 25, 0, 0, 0, 0, 26,
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    0, 0, 0, 0, 0, 0, 0, 0, 0, 0, 0, 0, 0, 0, 0, 0,
};
static const unsigned char GAME_ROOM_MOONMIST[256] = {
    0, 0, 27, 0, 0, 0, 0, 19, 0, 7, 0, 12, 0, 2, 23, 0,
    0, 0, 0, 0, 0, 0, 0, 0, 0, 0, 0, 23, 0, 0, 18, 0,
    17, 19, 0, 0, 0, 0, 0, 23, 8, 0, 0, 0, 0, 0, 0, 0,
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    0, 9, 0, 23, 0, 0, 0, 0, 0, 2, 0, 0, 23, 0, 0, 0,
};
static const unsigned char GAME_ROOM_MZORKI[256] = {
    0, 9, 13, 0, 0, 0, 0, 0, 0, 0, 0, 0, 0, 0, 0, 0,
    0, 10, 0, 0, 0, 0, 13, 6, 6, 8, 22, 0, 5, 0, 9, 5,
    0, 0, 0, 0, 10, 0, 0, 0, 0, 0, 0, 0, 0, 0, 0, 0,
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    0, 0, 0, 0, 0, 0, 0, 0, 0, 0, 0, 0, 0, 0, 0, 0,
};
static const unsigned char GAME_ROOM_MZORKI2[256] = {
    0, 0, 0, 0, 0, 0, 0, 0, 0, 0, 0, 0, 0, 0, 9, 4,
    0, 0, 18, 5, 0, 0, 22, 9, 29, 0, 6, 0, 13, 0, 0, 0,
    6, 8, 6, 0, 0, 0, 9, 9, 0, 0, 0, 0, 0, 0, 13, 0,
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    0, 0, 0, 0, 0, 0, 0, 0, 0, 0, 0, 0, 0, 0, 0, 0,
};
static const unsigned char GAME_ROOM_MZORKII[256] = {
    0, 0, 0, 0, 0, 0, 0, 0, 0, 0, 0, 0, 4, 0, 0, 0,
    0, 0, 0, 0, 0, 0, 0, 0, 0, 0, 0, 0, 0, 0, 4, 0,
    0, 0, 0, 23, 0, 0, 0, 0, 0, 0, 0, 0, 0, 0, 0, 0,
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    0, 0, 0, 0, 0, 0, 0, 0, 0, 0, 0, 0, 0, 0, 0, 0,
};
static const unsigned char GAME_ROOM_PLNDHRTS[256] = {
    0, 1, 27, 0, 0, 0, 0, 0, 0, 0, 0, 0, 0, 0, 0, 0,
    0, 0, 0, 0, 0, 18, 0, 0, 0, 0, 27, 0, 23, 0, 23, 0,
    0, 0, 8, 0, 0, 0, 0, 0, 0, 0, 0, 0, 0, 0, 0, 0,
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    0, 0, 0, 0, 0, 0, 0, 0, 0, 0, 0, 0, 0, 0, 0, 0,
};
static const unsigned char GAME_ROOM_PLNTFALL[256] = {
    0, 0, 0, 0, 0, 0, 0, 0, 0, 0, 0, 0, 0, 0, 0, 0,
    0, 0, 0, 0, 0, 0, 0, 0, 25, 0, 0, 25, 0, 25, 0, 0,
    0, 0, 0, 0, 0, 0, 25, 0, 0, 25, 0, 0, 0, 0, 0, 23,
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    0, 0, 0, 0, 0, 0, 0, 0, 0, 0, 0, 0, 0, 0, 0, 0,
};
static const unsigned char GAME_ROOM_SEASTLKR[256] = {
    0, 0, 0, 0, 0, 0, 0, 0, 0, 0, 0, 0, 0, 0, 0, 0,
    0, 0, 0, 0, 0, 0, 0, 0, 0, 0, 0, 0, 0, 0, 0, 0,
    0, 0, 0, 0, 0, 0, 0, 0, 0, 0, 0, 0, 0, 0, 0, 0,
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    0, 0, 8, 0, 0, 0, 0, 0, 0, 0, 0, 0, 0, 0, 0, 0,
};
static const unsigned char GAME_ROOM_SORCERER[256] = {
    0, 0, 0, 6, 0, 27, 0, 0, 0, 0, 0, 0, 0, 0, 0, 0,
    0, 0, 0, 0, 0, 0, 0, 0, 0, 10, 0, 0, 0, 0, 0, 0,
    0, 0, 0, 0, 1, 0, 0, 0, 0, 0, 0, 22, 0, 0, 0, 0,
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    0, 0, 11, 0, 0, 0, 0, 0, 0, 0, 0, 0, 0, 0, 23, 9,
};
static const unsigned char GAME_ROOM_SPLBRKR[256] = {
    0, 0, 0, 0, 0, 0, 0, 0, 0, 0, 0, 0, 0, 0, 0, 0,
    0, 0, 0, 0, 0, 0, 0, 0, 0, 0, 0, 0, 0, 0, 0, 0,
    0, 0, 0, 0, 0, 0, 0, 0, 0, 0, 0, 0, 0, 0, 0, 0,
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    0, 0, 0, 0, 0, 0, 0, 0, 0, 0, 0, 0, 0, 0, 0, 0,
};
static const unsigned char GAME_ROOM_STARCROS[256] = {
    0, 0, 0, 0, 0, 0, 0, 0, 0, 0, 0, 0, 0, 0, 0, 0,
    0, 14, 0, 0, 23, 0, 0, 0, 0, 0, 0, 0, 0, 0, 0, 0,
    23, 16, 0, 0, 0, 0, 0, 0, 0, 0, 0, 1, 0, 0, 0, 0,
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    0, 0, 0, 0, 0, 0, 0, 0, 0, 0, 0, 0, 0, 0, 0, 0,
};
static const unsigned char GAME_ROOM_STATFALL[256] = {
    0, 0, 0, 0, 0, 0, 0, 0, 0, 0, 0, 0, 0, 0, 0, 0,
    0, 0, 0, 24, 28, 0, 24, 0, 0, 0, 0, 0, 0, 0, 0, 0,
    16, 26, 0, 0, 24, 24, 0, 0, 0, 0, 0, 0, 8, 0, 0, 0,
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    0, 0, 0, 0, 0, 23, 0, 0, 0, 24, 0, 0, 0, 10, 0, 0,
};
static const unsigned char GAME_ROOM_SUSPECT[256] = {
    0, 0, 0, 0, 0, 0, 0, 0, 0, 0, 0, 0, 0, 0, 0, 0,
    0, 0, 0, 0, 0, 0, 0, 0, 0, 0, 0, 0, 0, 0, 0, 0,
    0, 0, 0, 0, 0, 0, 0, 0, 0, 0, 0, 0, 0, 0, 0, 0,
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    0, 0, 0, 0, 23, 0, 0, 0, 0, 0, 0, 0, 13, 0, 7, 0,
};
static const unsigned char GAME_ROOM_SUSPENDD[256] = {
    0, 0, 0, 0, 0, 0, 0, 0, 0, 0, 0, 0, 0, 0, 0, 0,
    0, 0, 0, 0, 0, 0, 0, 0, 0, 0, 0, 0, 0, 0, 0, 0,
    0, 0, 0, 0, 0, 0, 0, 0, 0, 0, 0, 0, 0, 0, 0, 0,
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    0, 0, 0, 0, 0, 0, 0, 0, 0, 0, 0, 0, 0, 0, 0, 0,
};
static const unsigned char GAME_ROOM_WISHBRNG[256] = {
    0, 0, 0, 0, 0, 0, 0, 0, 0, 0, 28, 0, 0, 0, 0, 0,
    0, 0, 0, 0, 5, 0, 4, 0, 0, 0, 0, 0, 0, 0, 0, 0,
    0, 0, 0, 0, 0, 0, 0, 0, 0, 0, 0, 0, 0, 0, 0, 0,
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    28, 0, 0, 0, 0, 7, 0, 0, 0, 0, 0, 0, 0, 0, 0, 0,
};
static const unsigned char GAME_ROOM_WITNESS[256] = {
    0, 0, 0, 0, 0, 0, 0, 0, 0, 0, 0, 0, 0, 0, 0, 0,
    0, 0, 0, 0, 0, 0, 0, 0, 0, 0, 0, 0, 0, 0, 0, 0,
    0, 0, 0, 0, 0, 0, 0, 0, 0, 0, 0, 0, 0, 0, 0, 0,
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    0, 0, 0, 0, 0, 0, 0, 0, 0, 0, 0, 0, 0, 0, 0, 0,
};
static const unsigned char GAME_ROOM_ZORK1[256] = {
    0, 0, 0, 0, 0, 0, 0, 0, 0, 0, 0, 0, 0, 0, 0, 8,
    10, 10, 10, 10, 0, 0, 0, 0, 10, 4, 4, 4, 0, 6, 5, 6,
    4, 4, 6, 6, 6, 11, 8, 8, 4, 8, 8, 8, 8, 8, 8, 8,
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    0, 0, 0, 0, 0, 0, 0, 0, 0, 0, 0, 0, 0, 0, 0, 0,
};
static const unsigned char GAME_ROOM_ZORK2[256] = {
    0, 0, 0, 0, 0, 0, 0, 0, 0, 0, 0, 0, 0, 0, 0, 0,
    0, 0, 0, 0, 0, 0, 0, 0, 0, 0, 0, 0, 0, 0, 0, 0,
    0, 0, 0, 0, 0, 0, 0, 0, 0, 0, 0, 0, 0, 0, 0, 0,
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    0, 0, 0, 0, 0, 0, 0, 0, 0, 0, 0, 0, 0, 0, 0, 0,
};
static const unsigned char GAME_ROOM_ZORK3[256] = {
    0, 0, 0, 0, 0, 0, 0, 0, 0, 0, 0, 0, 0, 0, 0, 5,
    0, 0, 0, 0, 0, 0, 0, 0, 0, 0, 0, 0, 0, 0, 0, 0,
    0, 0, 0, 0, 0, 0, 0, 0, 0, 0, 0, 0, 0, 5, 0, 0,
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    0, 0, 0, 0, 0, 0, 0, 0, 0, 0, 0, 0, 0, 0, 0, 0,
};
static const GameRoomMap GAME_ROOM_MAP[GAME_N] = {
    { 1, "151001", GAME_ROOM_ADVENT },
    { 97, "851218", GAME_ROOM_BALLYHOO },
    { 23, "840809", GAME_ROOM_CUTHROAT },
    { 27, "831005", GAME_ROOM_DEADLINE },
    { 29, "860820", GAME_ROOM_ENCHANTR },
    { 59, "851108", GAME_ROOM_HITCHHKR },
    { 37, "861215", GAME_ROOM_HOLYWOOD },
    { 11, "870225", GAME_ROOM_HYPOCOND },
    { 22, "830916", GAME_ROOM_INFIDEL },
    { 55, "850823", GAME_ROOM_INFOSAM5 },
    { 8, "870601", GAME_ROOM_INFOSAM7 },
    { 59, "860730", GAME_ROOM_LEATHERG },
    { 219, "870912", GAME_ROOM_LURKING },
    { 9, "861022", GAME_ROOM_MOONMIST },
    { 2, "840207", GAME_ROOM_MZORKI },
    { 34, "871124", GAME_ROOM_MZORKI2 },
    { 2, "871123", GAME_ROOM_MZORKII },
    { 26, "870730", GAME_ROOM_PLNDHRTS },
    { 37, "851003", GAME_ROOM_PLNTFALL },
    { 16, "850603", GAME_ROOM_SEASTLKR },
    { 15, "851108", GAME_ROOM_SORCERER },
    { 87, "860904", GAME_ROOM_SPLBRKR },
    { 17, "821021", GAME_ROOM_STARCROS },
    { 107, "870430", GAME_ROOM_STATFALL },
    { 14, "841005", GAME_ROOM_SUSPECT },
    { 8, "840521", GAME_ROOM_SUSPENDD },
    { 69, "850920", GAME_ROOM_WISHBRNG },
    { 22, "840924", GAME_ROOM_WITNESS },
    { 88, "840726", GAME_ROOM_ZORK1 },
    { 48, "840904", GAME_ROOM_ZORK2 },
    { 17, "840727", GAME_ROOM_ZORK3 },
};
